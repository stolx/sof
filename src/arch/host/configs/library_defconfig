## src/arch/host/configs/library_defconfig
```kconfig
CONFIG_LIBRARY=y
CONFIG_DEBUG_MEMORY_USAGE_SCAN=n
CONFIG_COMP_CODEC_ADAPTER=y
CONFIG_WAVES_CODEC=y
```

## src/arch/xtensa/configs/tgplp_defconfig
```kconfig
CONFIG_TIGERLAKE=y
CONFIG_INTEL_DMIC=y
CONFIG_INTEL_SSP=y
CONFIG_INTEL_ALH=y
CONFIG_LP_MEMORY_BANKS=1
CONFIG_HP_MEMORY_BANKS=46
CONFIG_DEBUG=y
CONFIG_TRACEV=y
CONFIG_COMP_CODEC_ADAPTER=y
CONFIG_WAVES_CODEC=y
```

## src/arch/xtensa/configs/tigerlake_defconfig
```kconfig
CONFIG_TIGERLAKE=y
CONFIG_INTEL_DMIC=y
CONFIG_INTEL_SSP=y
CONFIG_INTEL_ALH=y
CONFIG_CORE_COUNT=4
CONFIG_LP_MEMORY_BANKS=1
CONFIG_HP_MEMORY_BANKS=46
CONFIG_PERFORMANCE_COUNTERS=y
CONFIG_DSP_RESIDENCY_COUNTERS=y
CONFIG_TRACE=y
CONFIG_TRACEE=y
CONFIG_TRACEV=y
CONFIG_TRACEM=y
CONFIG_COMP_CODEC_ADAPTER=y
CONFIG_WAVES_CODEC=y
```
